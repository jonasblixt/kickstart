## ks-external/Config.in
```kconfig
source "$BR2_EXTERNAL_KICKSTART_PATH/package/bpak/Config.in"
source "$BR2_EXTERNAL_KICKSTART_PATH/package/nanomq/Config.in"
```

## ks-external/board/ks/qemu/br_defconfig
```kconfig
BR2_aarch64=y
BR2_TOOLCHAIN_EXTERNAL=y
BR2_GLOBAL_PATCH_DIR="$(BR2_EXTERNAL_KICKSTART_PATH)/patches"
BR2_PER_PACKAGE_DIRECTORIES=y
BR2_TARGET_GENERIC_HOSTNAME="kickstart"
BR2_ROOTFS_OVERLAY="$(BR2_EXTERNAL_KICKSTART_PATH)/board/ks/qemu/rootfs_overlay"
BR2_LINUX_KERNEL=y
BR2_LINUX_KERNEL_USE_CUSTOM_CONFIG=y
BR2_LINUX_KERNEL_CUSTOM_CONFIG_FILE="$(BR2_EXTERNAL_KICKSTART_PATH)/board/ks/qemu/linux_defconfig"
BR2_PACKAGE_PYTHON3=y
BR2_PACKAGE_PYTHON3_SSL=y
BR2_PACKAGE_PYTHON_AIOSQLITE=y
BR2_PACKAGE_PYTHON_PARAMIKO=y
BR2_PACKAGE_PYTHON_PROTOBUF=y
BR2_PACKAGE_PYTHON_PSUTIL=y
BR2_PACKAGE_PYTHON_PYROUTE2=y
BR2_PACKAGE_PYTHON_PYZMQ=y
BR2_PACKAGE_PYTHON_SETUPTOOLS=y
BR2_PACKAGE_CA_CERTIFICATES=y
BR2_PACKAGE_LIBOPENSSL_BIN=y
BR2_PACKAGE_PKCS11_HELPER=y
BR2_PACKAGE_TPM2_PKCS11=y
BR2_PACKAGE_LIBUSB=y
BR2_PACKAGE_OPENSC=y
BR2_PACKAGE_MOSQUITTO=y
BR2_PACKAGE_OPTEE_TEST=y
BR2_TARGET_ROOTFS_SQUASHFS=y
BR2_TARGET_ARM_TRUSTED_FIRMWARE=y
BR2_TARGET_ARM_TRUSTED_FIRMWARE_PLATFORM="qemu"
BR2_TARGET_ARM_TRUSTED_FIRMWARE_BL31=y
BR2_TARGET_ARM_TRUSTED_FIRMWARE_BL32_OPTEE=y
BR2_TARGET_ARM_TRUSTED_FIRMWARE_EDK2_AS_BL33=y
BR2_TARGET_ARM_TRUSTED_FIRMWARE_ADDITIONAL_VARIABLES="V=1"
BR2_TARGET_ARM_TRUSTED_FIRMWARE_DEBUG=y
BR2_TARGET_EDK2=y
BR2_TARGET_EDK2_PLATFORM_ARM_VIRT_QEMU_KERNEL=y
BR2_TARGET_OPTEE_OS=y
BR2_TARGET_OPTEE_OS_PLATFORM="vexpress-qemu_armv8a"
BR2_TARGET_OPTEE_OS_ADDITIONAL_VARIABLES="CFG_PKCS11_TA=y CFG_USER_TA_TARGET_pkcs11=ta_arm64"
BR2_PACKAGE_HOST_ENVIRONMENT_SETUP=y
```

## ks-external/board/ks/qemu/linux_defconfig
```kconfig
CONFIG_DEFAULT_HOSTNAME="kickstart"
CONFIG_NAMESPACES=y
CONFIG_EXPERT=y
CONFIG_ARCH_VEXPRESS=y
CONFIG_CMDLINE="console=ttyAMA0"
# CONFIG_GCC_PLUGINS is not set
CONFIG_MODULES=y
CONFIG_NET=y
CONFIG_PACKET=y
CONFIG_UNIX=y
CONFIG_INET=y
CONFIG_NETFILTER=y
CONFIG_NETLINK_DIAG=y
CONFIG_PCI=y
CONFIG_PCI_HOST_GENERIC=y
CONFIG_DEVTMPFS=y
CONFIG_DEVTMPFS_MOUNT=y
# CONFIG_VEXPRESS_CONFIG is not set
CONFIG_VIRTIO_BLK=y
CONFIG_NETDEVICES=y
CONFIG_TUN=y
CONFIG_VIRTIO_NET=y
# CONFIG_WLAN is not set
CONFIG_VT_HW_CONSOLE_BINDING=y
CONFIG_SERIAL_AMBA_PL011=y
CONFIG_SERIAL_AMBA_PL011_CONSOLE=y
CONFIG_VIRTIO_CONSOLE=y
CONFIG_HW_RANDOM=y
# CONFIG_PTP_1588_CLOCK is not set
CONFIG_GPIO_SYSFS=y
CONFIG_GPIO_PL061=y
CONFIG_HID_A4TECH=y
CONFIG_HID_BELKIN=y
CONFIG_HID_CHERRY=y
CONFIG_HID_CYPRESS=y
CONFIG_HID_EZKEY=y
CONFIG_HID_ITE=y
CONFIG_HID_KENSINGTON=y
CONFIG_HID_REDRAGON=y
CONFIG_HID_MICROSOFT=y
CONFIG_HID_MONTEREY=y
CONFIG_RTC_CLASS=y
CONFIG_RTC_DRV_EFI=y
CONFIG_RTC_DRV_PL031=y
CONFIG_VIRTIO_PCI=y
CONFIG_VIRTIO_MMIO=y
CONFIG_VIRTIO_MMIO_CMDLINE_DEVICES=y
CONFIG_TEE=y
CONFIG_OPTEE=y
CONFIG_TMPFS=y
CONFIG_EFIVAR_FS=y
CONFIG_SQUASHFS=y
# CONFIG_FTRACE is not set
```

## ks-external/package/bpak/Config.in
```kconfig
config BR2_PACKAGE_BPAK
	bool "bpak"
	depends on BR2_PACKAGE_MBEDTLS
	depends on BR2_PACKAGE_XZ
	help
        Bitpacker library

if BR2_PACKAGE_BPAK
config BR2_PACKAGE_BPAK_TOOL
	bool "tool"
	depends on BR2_PACKAGE_BPAK
	help
	  Build the BPAK tool
endif

config BR2_PACKAGE_HOST_BPAK
	bool "host bpak"
	help
        Bitpacker tool and library
```

## ks-external/package/nanomq/Config.in
```kconfig
config BR2_PACKAGE_NANOMQ
	bool "nanomq"
	depends on BR2_PACKAGE_WOLFSSL
	help
        NanoMQ MQTT broker
```
